AUTOSAR XML (schema 4.0)
package /Sanitized
  module config Can
    CAN1 (): CanControllerBaudRate=500, CanControllerFdBaudRate=2000, CanControllerTxBitRateSwitch=true
