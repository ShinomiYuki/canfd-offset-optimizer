AUTOSAR XML (schema 4.0)
package /Sanitized
  module config Can
    CAN1 (): CanControllerBaudrate=500000, CanControllerFdDataRate=2000000, CanControllerFdBrs=true
